## conf/machine/bananapi-m2-berry.conf
```bitbake
#@TYPE: Machine
#@NAME: bananapi-m2-berry
#@DESCRIPTION: Machine configuration for the bananapi-m2-berry, base on allwinner R40/V40/A40i/T3 CPU

require conf/machine/include/sun8i.inc

KERNEL_DEVICETREE = "sun8i-v40-bananapi-m2-berry.dtb"
UBOOT_MACHINE = "bananapi_m2_berry_defconfig"
```

## conf/machine/bananapi-m2-magic.conf
```bitbake
#@TYPE: Machine
#@NAME: bananapi-m2-magic
#@DESCRIPTION: Machine configuration for the bananapi-m2-magic, base on allwinner R16/A33 CPU

require conf/machine/include/sun8i.inc

KERNEL_DEVICETREE = "sun8i-r16-bananapi-m2m.dtb"
UBOOT_MACHINE = "Bananapi_m2m_defconfig"
```

## conf/machine/bananapi-m2-plus-h5.conf
```bitbake
#@TYPE: Machine
#@NAME: bananapi-m2-plus-h5
#@DESCRIPTION: Machine configuration for the bananapi-m2-plus-h5, base on Allwinner H5 CPU


require conf/machine/include/sun50i.inc

KERNEL_DEVICETREE = "allwinner/sun50i-h5-bananapi-m2-plus.dtb"
UBOOT_MACHINE = "bananapi_m2_plus_h5_defconfig"
```

## conf/machine/bananapi-m2-plus.conf
```bitbake
#@TYPE: Machine
#@NAME: bananapi-m2-plus
#@DESCRIPTION: Machine configuration for the bananapi-m2-plus, base on allwinner H3 CPU

require conf/machine/include/sun8i.inc

KERNEL_DEVICETREE = "sun8i-h3-bananapi-m2-plus.dtb"
UBOOT_MACHINE = "bananapi_m2_plus_h3_defconfig"
```

## conf/machine/bananapi-m2-ultra.conf
```bitbake
#@TYPE: Machine
#@NAME: bananapi-m2-ultra
#@DESCRIPTION: Machine configuration for the bananapi-m2-ultra, base on allwinner R40/V40/A40i/T3 CPU

require conf/machine/include/sun8i.inc

KERNEL_DEVICETREE = "sun8i-r40-bananapi-m2-ultra.dtb"
UBOOT_MACHINE = "Bananapi_M2_Ultra_defconfig"
```

## conf/machine/bananapi-m2-zero.conf
```bitbake
#@TYPE: Machine
#@NAME: bananapi-m2-zero
#@DESCRIPTION: Machine configuration for the bananapi-m2-zero, base on allwinner H2+ CPU

require conf/machine/include/sun8i.inc

KERNEL_DEVICETREE = "sun8i-h2-plus-bananapi-m2-zero.dtb"
UBOOT_MACHINE = "bananapi_m2_zero_defconfig"
```

## conf/machine/bananapi-m2.conf
```bitbake
#@TYPE: Machine
#@NAME: bananapi-m2
#@DESCRIPTION: Machine configuration for the bananapi-m2, base on allwinner a31s CPU

require conf/machine/include/sun6i.inc

KERNEL_DEVICETREE = "sun6i-a31s-sinovoip-bpi-m2.dtb"
UBOOT_MACHINE = "Sinovoip_BPI_M2_defconfig"
```

## conf/machine/bananapi-m3.conf
```bitbake
#@TYPE: Machine
#@NAME: bananapi-m3
#@DESCRIPTION: Machine configuration for the bananapi-m3, base on allwinner A83T CPU

require conf/machine/include/sun8i.inc

KERNEL_DEVICETREE = "sun8i-a83t-bananapi-m3.dtb"
UBOOT_MACHINE = "Sinovoip_BPI_M3_defconfig"
```

## conf/machine/bananapi-m64.conf
```bitbake
#@TYPE: Machine
#@NAME: bananapi-m64
#@DESCRIPTION: Machine configuration for the bananapi-m64, based on Allwinner A64 CPU


require conf/machine/include/sun50i.inc

KERNEL_DEVICETREE = "allwinner/sun50i-a64-bananapi-m64.dtb"
UBOOT_MACHINE = "bananapi_m64_defconfig"
```

## conf/machine/bananapi-p2-zero.conf
```bitbake
#@TYPE: Machine
#@NAME: bananapi-p2-zero
#@DESCRIPTION: Machine configuration for the bananapi-p2-zero, base on allwinner H2+ CPU

require conf/machine/include/sun8i.inc

KERNEL_DEVICETREE = "sun8i-h2-plus-bananapi-p2-zero.dtb"
UBOOT_MACHINE = "bananapi_p2_zero_defconfig"
```

## conf/machine/bananapi-r1.conf
```bitbake
#@TYPE: Machine
#@NAME: bananapi-r1
#@DESCRIPTION: Machine configuration for the bananapi-r1, based on allwinner A20 CPU http://banana-pi.org/

require conf/machine/include/sun7i.inc

KERNEL_DEVICETREE = "sun7i-a20-lamobo-r1.dtb"
UBOOT_MACHINE = "Lamobo_R1_defconfig"
SUNXI_FEX_FILE = "sys_config/a20/lamobo-r1.fex"
```
